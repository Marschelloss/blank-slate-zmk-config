## config/west.yml
```yaml
manifest:
  remotes:
    - name: zmkfirmware
      url: https://github.com/zmkfirmware/zmk
    - name: urob
      url-base: https://github.com/urob
    - name: petejohanson
      url-base: https://github.com/petejohanson
    - name: marschelloss
      url-base: https://github.com/Marschelloss
    - name: caksoylar
      url-base: https://github.com/caksoylar
  projects:
    - name: zmk
      remote: zmkfirmware
      revision: main
      import: app/west.yml
    - name: blank-slate-zmk-module
      remote: petejohanson
      revision: main
  self:
    path: config
```
